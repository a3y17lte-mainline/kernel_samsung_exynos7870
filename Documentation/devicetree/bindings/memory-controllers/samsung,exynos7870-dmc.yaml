## Documentation/devicetree/bindings/memory-controllers/samsung,exynos7870-dmc.yaml
```yaml
# SPDX-License-Identifier: (GPL-2.0-only OR BSD-2-Clause)
%YAML 1.2
---
$id: http://devicetree.org/schemas/memory-controllers/samsung,exynos7870-dmc.yaml#
$schema: http://devicetree.org/meta-schemas/core.yaml#

title: Samsung Exynos7870 DRAM controller frequency scaling

maintainers:
  - Martin Štrobl <recordyletsplays@gmail.com>

description:
  The DRAM controller (DREX) of the Exynos7870 and its PHY run from MEM_PLL.
  To change the memory frequency, the PHY clock is moved to a switching clock
  from MEDIA_PLL, MEM_PLL is relocked and the PHY clock moved back. Each move
  makes the clock unit pause the controller, which then switches to the other
  of its two timing parameter sets. The memory frequency follows the CPU
  frequency through the required-opps of the CPU OPP tables.

properties:
  compatible:
    const: samsung,exynos7870-dmc

  reg:
    items:
      - description: DREX controller registers
      - description: DREX performance filter registers
      - description: DREX PHY registers
      - description: Clock unit pause control registers of CMU_MIF

  reg-names:
    items:
      - const: drex
      - const: pf
      - const: phy
      - const: pause

  clocks:
    items:
      - description: MEM_PLL output
      - description: MEM_PLL divided by two
      - description: BUS_PLL output
      - description: BUS_PLL divided by two
      - description: MEDIA_PLL divided by two
      - description: PHY clock mux
      - description: MEM_PLL input of the PHY clock mux
      - description: Switching clock input of the PHY clock mux
      - description: MIF data bus clock mux
      - description: MIF data bus clock divider
      - description: CCI bus clock mux
      - description: CCI bus clock divider

  clock-names:
    items:
      - const: mem_pll
      - const: mem_pll_div2
      - const: bus_pll
      - const: bus_pll_div2
      - const: media_pll_div2
      - const: phy_clk2x
      - const: phy_mem
      - const: phy_switch
      - const: busd_mux
      - const: busd
      - const: cci_mux
      - const: cci

  operating-points-v2: true

  vdd-supply:
    description: Supply of the memory interface.

required:
  - compatible
  - reg
  - reg-names
  - clocks
  - clock-names
  - operating-points-v2
  - vdd-supply

additionalProperties: false

examples:
  - |
    #include <dt-bindings/clock/samsung,exynos7870-cmu.h>

    memory-controller@10400000 {
        compatible = "samsung,exynos7870-dmc";
        reg = <0x10400000 0x1000>, <0x10410000 0x100>,
              <0x10440000 0x1000>, <0x10461000 0x10>;
        reg-names = "drex", "pf", "phy", "pause";
        clocks = <&cmu_mif CLK_FOUT_MIF_MEM_PLL>,
                 <&cmu_mif CLK_FFAC_MIF_MUX_MEM_PLL_DIV2>,
                 <&cmu_mif CLK_GOUT_MIF_MUX_BUS_PLL>,
                 <&cmu_mif CLK_FFAC_MIF_MUX_BUS_PLL_DIV2>,
                 <&cmu_mif CLK_FFAC_MIF_MUX_MEDIA_PLL_DIV2>,
                 <&cmu_mif CLK_MOUT_MIF_PHY_CLK2X>,
                 <&cmu_mif CLK_GOUT_MIF_MUX_MEM_PLL>,
                 <&cmu_mif CLK_GOUT_MIF_MUX_PHY_SWITCH>,
                 <&cmu_mif CLK_MOUT_MIF_BUSD>,
                 <&cmu_mif CLK_DOUT_MIF_BUSD>,
                 <&cmu_mif CLK_MOUT_MIF_CCI>,
                 <&cmu_mif CLK_DOUT_MIF_CCI>;
        clock-names = "mem_pll", "mem_pll_div2", "bus_pll", "bus_pll_div2",
                      "media_pll_div2", "phy_clk2x", "phy_mem", "phy_switch",
                      "busd_mux", "busd", "cci_mux", "cci";
        operating-points-v2 = <&dmc_opp_table>;
        vdd-supply = <&vdd_buck2>;
    };
```

## Documentation/devicetree/bindings/net/samsung,exynos7870-modem.yaml
```yaml
# SPDX-License-Identifier: (GPL-2.0-only OR BSD-2-Clause)
%YAML 1.2
---
$id: http://devicetree.org/schemas/net/samsung,exynos7870-modem.yaml#
$schema: http://devicetree.org/meta-schemas/core.yaml#

title: Samsung Exynos integrated cellular modem

maintainers:
  - Martin Štrobl <recordyletsplays@gmail.com>

description:
  Some Exynos SoCs contain a cellular modem (communication processor, "CP",
  Shannon series) next to the application processor. The modem runs its
  firmware from a region of the system RAM that the bootloader has set aside
  and assigned to it. The application processor loads the firmware, starts the
  modem through the power management unit and then exchanges messages with it
  through a mailbox and a second, shared region of RAM.

properties:
  compatible:
    const: samsung,exynos7870-modem

  interrupts:
    items:
      - description: the modem failed to boot
      - description: the modem's watchdog expired

  interrupt-names:
    items:
      - const: fail
      - const: watchdog

  mboxes:
    items:
      - description: link messages
      - description: link status and flow control
      - description:
          performance request of the modem, and sleep state of the application
          processor in the other direction
      - description: the modem is active
      - description: CPU frequency request of the modem
      - description: memory interface frequency request of the modem
      - description: internal bus frequency request of the modem

  mbox-names:
    items:
      - const: msg
      - const: status
      - const: perf
      - const: active
      - const: perf-cpu
      - const: perf-mif
      - const: perf-int

  memory-region:
    items:
      - description: memory of the modem, which receives its firmware
      - description: memory shared between application processor and modem
      - description:
          data that the bootloader left for the loader of the modem, such as
          the memory configuration

  memory-region-names:
    items:
      - const: firmware
      - const: ipc
      - const: bootinfo

  firmware-name:
    items:
      - description:
          the firmware image, as the board's RADIO partition holds it
      - description:
          the modem's non-volatile data, which the modem changes while it runs

  samsung,syscon-phandle:
    $ref: /schemas/types.yaml#/definitions/phandle
    description: the power management unit, which controls the modem's power

  samsung,mif-devfreq:
    $ref: /schemas/types.yaml#/definitions/phandle
    description:
      The memory controller. The modem shares the DRAM, follows the memory
      interface frequency and can ask for a minimum.

  samsung,int-devfreq:
    $ref: /schemas/types.yaml#/definitions/phandle
    description:
      The internal bus, for which the modem can ask for a minimum frequency.

  samsung,board-revision:
    $ref: /schemas/types.yaml#/definitions/uint32
    maximum: 255
    description:
      Hardware revision of the board as the bootloader counts it. The modem
      firmware uses it to select its radio configuration.

  samsung,dual-sim:
    type: boolean
    description: the board has two SIM slots

required:
  - compatible
  - interrupts
  - interrupt-names
  - mboxes
  - mbox-names
  - memory-region
  - memory-region-names
  - firmware-name
  - samsung,syscon-phandle

additionalProperties: false

examples:
  - |
    #include <dt-bindings/interrupt-controller/arm-gic.h>

    modem {
        compatible = "samsung,exynos7870-modem";
        interrupts = <GIC_SPI 18 IRQ_TYPE_LEVEL_HIGH>,
                     <GIC_SPI 479 IRQ_TYPE_LEVEL_HIGH>;
        interrupt-names = "fail", "watchdog";
        mboxes = <&mbox_cp 0>, <&mbox_cp 2>, <&mbox_cp 3>, <&mbox_cp 4>,
                 <&mbox_cp 5>, <&mbox_cp 6>, <&mbox_cp 7>;
        mbox-names = "msg", "status", "perf", "active", "perf-cpu",
                     "perf-mif", "perf-int";
        memory-region = <&modem_firmware>, <&modem_ipc>, <&modem_bootinfo>;
        memory-region-names = "firmware", "ipc", "bootinfo";
        samsung,syscon-phandle = <&pmu_system_controller>;
        samsung,mif-devfreq = <&dmc>;
        samsung,int-devfreq = <&bus_int>;
        firmware-name = "samsung/a3y17lte/modem.bin",
                        "samsung/a3y17lte/modem-nv.bin";
        samsung,board-revision = <4>;
    };
```

## drivers/memory/samsung/Kconfig
```kconfig
# SPDX-License-Identifier: GPL-2.0
config SAMSUNG_MC
	bool "Samsung Exynos Memory Controller support" if COMPILE_TEST
	default ARCH_EXYNOS
	help
	  Support for the Memory Controller (MC) devices found on
	  Samsung Exynos SoCs.

if SAMSUNG_MC

config EXYNOS5422_DMC
	tristate "Exynos5422 Dynamic Memory Controller driver"
	depends on ARCH_EXYNOS || (COMPILE_TEST && HAS_IOMEM)
	select DDR
	depends on DEVFREQ_GOV_SIMPLE_ONDEMAND
	depends on (PM_DEVFREQ && PM_DEVFREQ_EVENT)
	help
	  This adds driver for Samsung Exynos5422 SoC DMC (Dynamic Memory
	  Controller).  The driver provides support for Dynamic Voltage and
	  Frequency Scaling in DMC and DRAM. It also supports changing timings
	  of DRAM running with different frequency. The timings are calculated
	  based on DT memory information.
	  If unsure, say Y on devices with Samsung Exynos SoCs.

config EXYNOS7870_DMC
	tristate "Exynos7870 DRAM controller frequency scaling"
	depends on ARCH_EXYNOS || (COMPILE_TEST && HAS_IOMEM)
	depends on PM_DEVFREQ && CPU_FREQ
	select DEVFREQ_GOV_PASSIVE
	help
	  Scale the frequency and voltage of the DRAM controller (MIF) of the
	  Samsung Exynos7870 SoC with the CPU frequency, as the vendor
	  bootloader's tables describe.

config EXYNOS_SROM
	bool "Exynos SROM controller driver" if COMPILE_TEST
	depends on (ARM && ARCH_EXYNOS) || (COMPILE_TEST && HAS_IOMEM)
	help
	  This adds driver for Samsung Exynos SoC SROM controller.  The driver
	  in basic operation mode only saves and restores SROM registers
	  during suspend.  If however appropriate device tree configuration
	  is provided, the driver enables support for external memory
	  or external devices.
	  If unsure, say Y on devices with Samsung Exynos SoCs.

endif
```
